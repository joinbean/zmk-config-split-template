#include "charybdis.dtsi"

&pro_micro_spi {
    status = "okay";
    cs-gpios = <&pro_micro 19 GPIO_ACTIVE_LOW>;

    trackball: trackball@0 {
        compatible = "pmw3360";
        reg = <0>;
        spi-max-frequency = <2000000>;
        status = "okay";
        
        // Interrupt pin
        irq-gpios = <&pro_micro 5 (GPIO_ACTIVE_LOW | GPIO_PULL_UP)>;
    };
};

&trackball_listener {
    status = "okay";
};

&default_transform {
    col-offset = <6>;
};
